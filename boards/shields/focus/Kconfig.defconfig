## boards/shields/focus/Kconfig.shield
```kconfig
config SHIELD_focus
    def_bool $(shields_list_contains, focus)

# set the NFC pins as GPIO
config NFCT_PINS_AS_GPIOS
	default y

config TRACING
    default n

config DEBUG
    default n

config BUILD_OUTPUT_UF2
	default n

# use this one
config ZMK_KEYBOARD_NAME
    default "FocusBoard"

# here below doesnt work
# CONFIG_ZMK_KEYBOARD_NAME="FocusKeyboard"

# CONFIG_ZMK_USB_VID=0x1234
# CONFIG_ZMK_USB_PID=0x5679

# 0x1234
config USB_DEVICE_VID
    default 0x1234

# 0x5678
config USB_DEVICE_PID
    default 0x5678
```

## config/boards/shields/lecarre116/Kconfig.defconfig
```kconfig
config ZMK_USB
    default y

    
if SHIELD_LECARRE116

config ZMK_KEYBOARD_NAME
    default "lecarre116"

endif
```
